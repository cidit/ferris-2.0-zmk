## boards/shields/ferris_rev02/Kconfig.defconfig
```kconfig
if SHIELD_FERRIS_BLING_LEFT

config ZMK_KEYBOARD_NAME
    default "ferris BLING"

config ZMK_SPLIT_ROLE_CENTRAL
    default y

endif

if SHIELD_FERRIS_BLING_LEFT || SHIELD_FERRIS_BLING_RIGHT

config ZMK_SPLIT
    default y

endif
```

## boards/shields/ferris_rev02/Kconfig.shield
```kconfig
config SHIELD_FERRIS_BLING_LEFT
    def_bool $(shields_list_contains,ferris_rev02)

config SHIELD_FERRIS_BLING_RIGHT
    def_bool $(shields_list_contains,ferris_rev02)
```
